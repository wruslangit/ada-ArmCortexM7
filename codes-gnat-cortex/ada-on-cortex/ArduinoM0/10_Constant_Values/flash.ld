OUTPUT_FORMAT("elf32-littlearm")
OUTPUT_ARCH(arm)

SECTIONS
{
    GPIOA_DIRCLR = 0x41004404;
    GPIOA_DIRSET = 0x41004408;
    GPIOA_OUTCLR = 0x41004414;
    GPIOA_OUTSET = 0x41004418;
    GPIOA_IN = 0x41004420;
    GPIOA_PINCFG8 = 0x41004448;
    GPIOA_PINCFG9 = 0x41004449;
    GPIOA_PINCFG14 = 0x4100444e;
    GPIOA_PINCFG15 = 0x4100444f;
    GPIOA_PINCFG20 = 0x41004454;
    GPIOA_PINCFG21 = 0x41004455;
    GPIOA_PINCFG6 = 0x41004446;
    GPIOA_PINCFG7 = 0x41004447;
    GPIOA_PINCFG18 = 0x41004452;
    GPIOA_PINCFG16 = 0x41004450;
    GPIOA_PINCFG19 = 0x41004453;
    GPIOA_PINCFG17 = 0x41004451;

    .vectors 0x00004000 :
    {
        LONG(0x20008000)
        LONG(run + 1)
        FILL(0)
    }

    .text 0x00004100 :
    {
        *(.text)
    }
}
