OUTPUT_FORMAT("elf32-littlearm")
OUTPUT_ARCH(arm)

SECTIONS
{
    PIOB_PER = 0x400E1000;
    PIOB_OER = 0x400E1010;
    PIOB_ODR = 0x400E1014;
    PIOB_PUER = 0x400E1064;
    PIOB_PUDR = 0x400E1060;
    PIOB_SODR = 0x400E1030;
    PIOB_CODR = 0x400E1034;
    PIOB_PDSR = 0x400E103C;

    PIOC_PER = 0x400E1200;
    PIOC_OER = 0x400E1210;
    PIOC_ODR = 0x400E1214;
    PIOC_PUER = 0x400E1264;
    PIOC_PUDR = 0x400E1260;
    PIOC_SODR = 0x400E1230;
    PIOC_CODR = 0x400E1234;
    PIOC_PDSR = 0x400E123C;

    PIOD_PER = 0x400E1400;
    PIOD_OER = 0x400E1410;
    PIOD_ODR = 0x400E1414;
    PIOD_PUER = 0x400E1464;
    PIOD_PUDR = 0x400E1460;
    PIOD_SODR = 0x400E1430;
    PIOD_CODR = 0x400E1434;
    PIOD_PDSR = 0x400E143C;

    PMC_PCER0 = 0x400E0610;
    PMC_PCER1 = 0x400E0700;
    
    TRNG_CR = 0x400BC000;
    TRNG_ISR = 0x400BC01C;
    TRNG_ODATA = 0x400BC050;

    .vectors 0x00080000 :
    {
        LONG(0x20088000)
        LONG(run + 1)
        FILL(0)
    }

    .text 0x00080100 :
    {
        *(.text)
    }
}
